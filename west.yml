## west.yml
```yaml
# The west manifest file for upstream Zephyr.
#
# The per-installation west configuration file, .west/config, sets the
# path to the project containing this file in the [manifest] section's
# "path" variable.
#
# You are free to create your own manifest files and put them in any
# repository you want, to create your own custom Zephyr installations.
# For example, you could create a manifest file in your own out of
# tree application directory, which would pull this zephyr repository
# in as an ordinary project.
#
# You can pass your manifest repositories to west init when creating a
# new Zephyr installation. See the west documentation for more
# information.

manifest:
  defaults:
    remote: upstream

  remotes:
    - name: upstream
      url-base: https://github.com/zephyrproject-rtos
    - name: ikart
      url-base: https://github.com/uikart

  group-filter: [-babblesim, -optional]

  #
  # Please add items below based on alphabetical order
  projects:
    - name: zephyr
      path: zephyr
      remote: ikart
      revision: master
    - name: acpica
      revision: 8d24867bc9c9d81c81eeac59391cda59333affd4
      path: modules/lib/acpica
    - name: cmsis
      revision: 4b96cbb174678dcd3ca86e11e1f24bc5f8726da0
      path: modules/hal/cmsis
      groups:
        - hal
    - name: cmsis-dsp
      revision: 6489e771e9c405f1763b52d64a3f17a1ec488ace
      path: modules/lib/cmsis-dsp
    - name: cmsis-nn
      revision: ea987c1ca661be723de83bd159aed815d6cbd430
      path: modules/lib/cmsis-nn
    - name: edtt
      revision: b9ca3c7030518f07b7937dacf970d37a47865a76
      path: tools/edtt
      groups:
        - tools
    - name: fatfs
      revision: 427159bf95ea49b7680facffaa29ad506b42709b
      path: modules/fs/fatfs
      groups:
        - fs
    - name: hal_rpi_pico
      path: modules/hal/rpi_pico
      revision: fba7162cc7bee06d0149622bbcaac4e41062d368
      groups:
        - hal
    - name: hal_st
      revision: b2f548fe672f24122c7f92027b2c9eeea8a0483a
      path: modules/hal/st
      groups:
        - hal
    - name: hal_stm32
      revision: 1ff820533c1b1c17f1a4d7d28ab99a94a234883b
      path: modules/hal/stm32
      groups:
        - hal
    - name: libmetal
      revision: a6851ba6dba8c9e87d00c42f171a822f7a29639b
      path: modules/hal/libmetal
      groups:
        - hal
    - name: liblc3
      revision: 1a5938ebaca4f13fe79ce074f5dee079783aa29f
      path: modules/lib/liblc3
    - name: littlefs
      path: modules/fs/littlefs
      groups:
        - fs
      revision: 009bcff0ed4853a53df8256039fa815bda6854dd
    - name: lvgl
      revision: 2b498e6f36d6b82ae1da12c8b7742e318624ecf5
      path: modules/lib/gui/lvgl
    - name: mbedtls
      revision: fb36f3fe20f9f62e67b1a20c0cfe0a6788ec2bf6
      path: modules/crypto/mbedtls
      groups:
        - crypto
    - name: mcuboot
      revision: e890df7ab975da181a9f3fb3abc470bf935625ab
      path: bootloader/mcuboot
      groups:
        - bootloader
    - name: mipi-sys-t
      path: modules/debug/mipi-sys-t
      groups:
        - debug
      revision: 71ace1f5caa03e56c8740a09863e685efb4b2360
    - name: net-tools
      revision: 93acc8bac4661e74e695eb1aea94c7c5262db2e2
      path: tools/net-tools
      groups:
        - tools
    - name: open-amp
      revision: 76d2168bcdfcd23a9a7dce8c21f2083b90a1e60a
      path: modules/lib/open-amp
    - name: openthread
      revision: e10a92570f94ff1e0bc5e0da9ecf0ee135d955a6
      path: modules/lib/openthread
    - name: percepio
      path: modules/debug/percepio
      revision: b68d17993109b9bee6b45dc8c9794e7b7bce236d
      groups:
        - debug
    - name: picolibc
      path: modules/lib/picolibc
      revision: 06bde1fd7531b1f788f6e42b6f7b358c0fe4f814
    - name: segger
      revision: b011c45b585e097d95d9cf93edf4f2e01588d3cd
      path: modules/debug/segger
      groups:
        - debug
    - name: tinycrypt
      revision: 1012a3ebee18c15ede5efc8332ee2fc37817670f
      path: modules/crypto/tinycrypt
      groups:
        - crypto
    - name: trusted-firmware-m
      revision: a11cd27905aecc4416cfc85552bfc3b997375056
      path: modules/tee/tf-m/trusted-firmware-m
      groups:
        - tee
    - name: trusted-firmware-a
      revision: 713ffbf96c5bcbdeab757423f10f73eb304eff07
      path: modules/tee/tf-a/trusted-firmware-a
      groups:
        - tee
    - name: uoscore-uedhoc
      revision: 84ef879a46d7bfd9a423fbfb502b04289861f9ea
      path: modules/lib/uoscore-uedhoc
    - name: zcbor
      revision: 47f34dd7f5284e8750b5a715dee7f77c6c5bdc3f
      path: modules/lib/zcbor

  self:
    path: zephyr
    west-commands: scripts/west-commands.yml
    import: submanifests
```
